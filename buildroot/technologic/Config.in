## buildroot/technologic/Config.in
```kconfig
source "$BR2_EXTERNAL_TS7990_BALLOON_PATH/package/balloon-pump-demo-ts-7990/Config.in"
```

## buildroot/technologic/package/balloon-pump-demo-ts-7990/Config.in
```kconfig
config BR2_PACKAGE_BALLOON_PUMP_DEMO_TS_7990
	bool "ts7990-balloon-demo"
	help
	  Balloon control demo for TS-TPC-7990
```

## buildroot/technologic/package/sfxx-driver/Config.in
```kconfig
config BR2_PACKAGE_SFXX_DRIVER
	bool "Sensirion sfxx kernel module"
	depends on BR2_LINUX_KERNEL
	help
	  External module from Sensirion to support their SF04 and
	  SF05 I2C airflow sensors.

	  https://github.com/Sensirion/sfxx
```
